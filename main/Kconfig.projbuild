## main/Kconfig.projbuild
```kconfig
menu "Configuration DHT11 MQTT"

    config DHT_WIFI_SSID
        string "Nom du Wi-Fi (SSID, 2,4 GHz)"
        default "Maison"

    config DHT_WIFI_PASSWORD
        string "Mot de passe du Wi-Fi"
        default "Danette95%"

    config DHT_MQTT_BROKER_URI
        string "URI du broker MQTT"
        default "mqtt://broker.hivemq.com"

    config DHT_MQTT_TOPIC_PREFIX
        string "Préfixe des topics (choisissez un nom unique)"
        default "mon-esp32-floooow2704/"

    config DHT_SLEEP_TIME_S
        int "Durée du deep sleep entre deux mesures (secondes)"
        range 10 86400
        default 300

endmenu
```
